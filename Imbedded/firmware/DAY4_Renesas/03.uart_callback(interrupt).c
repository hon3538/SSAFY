#include "hal_data.h"

FSP_CPP_HEADER
void R_BSP_WarmStart(bsp_warm_start_event_t event);
FSP_CPP_FOOTER
uint8_t temp_buf[100]; //한 글자씩 넘어오는 문자 저장할 배열
int cnt_val; //넘어온 개수
/* Callback function */
void kfc_input(uart_callback_args_t *p_args)
{
    /* TODO: add your own code here */
    if(UART_EVENT_RX_CHAR == p_args->event)
       {
           //key 눌릴때마다 입력 입력 받는다.
           temp_buf[cnt_val++]=(uint8_t)p_args->data;
       }
}

/*******************************************************************************************************************//**
 * main() is generated by the RA Configuration editor and is used to generate threads if an RTOS is used.  This function
 * is called by main() when no RTOS is used.
 **********************************************************************************************************************/
void hal_entry(void)
{
    /* TODO: add your own code here */
    while(1){
        //2초단위로 입력 받은 buf를 출력
        R_BSP_SoftwareDelay (2000, BSP_DELAY_UNITS_MILLISECONDS);
        if(cnt_val>0){
            R_SCI_UART_Write(&g_uart0_ctrl, temp_buf, cnt_val);
            //uart 전송이 완료될 때까지 잠시 대기
            R_BSP_SoftwareDelay (100, BSP_DELAY_UNITS_MILLISECONDS);
            memset(temp_buf,0,sizeof(temp_buf));
            cnt_val=0;

        }
    }

}

/*******************************************************************************************************************//**
 * This function is called at various points during the startup process.  This implementation uses the event that is
 * called right before main() to set up the pins.
 *
 * @param[in]  event    Where at in the start up process the code is currently at
 **********************************************************************************************************************/
void R_BSP_WarmStart(bsp_warm_start_event_t event)
{
    if (BSP_WARM_START_RESET == event)
    {
#if BSP_FEATURE_FLASH_LP_VERSION != 0

        /* Enable reading from data flash. */
        R_FACI_LP->DFLCTL = 1U;

        /* Would normally have to wait tDSTOP(6us) for data flash recovery. Placing the enable here, before clock and
         * C runtime initialization, should negate the need for a delay since the initialization will typically take more than 6us. */
#endif
    }

    if (BSP_WARM_START_POST_C == event)
    {
        /* C runtime environment and system clocks are setup. */

        /* Configure pins. */
        R_IOPORT_Open (&g_ioport_ctrl, g_ioport.p_cfg);
        R_SCI_UART_Open(&g_uart0_ctrl, &g_uart0_cfg);

    }
}

#if BSP_TZ_SECURE_BUILD

FSP_CPP_HEADER
BSP_CMSE_NONSECURE_ENTRY void template_nonsecure_callable ();

/* Trustzone Secure Projects require at least one nonsecure callable function in order to build (Remove this if it is not required to build). */
BSP_CMSE_NONSECURE_ENTRY void template_nonsecure_callable ()
{

}
FSP_CPP_FOOTER

#endif
