#include "hal_data.h"
#include <stdio.h>
FSP_CPP_HEADER
void R_BSP_WarmStart(bsp_warm_start_event_t event);
FSP_CPP_FOOTER

static volatile uint8_t g_data_transmit_flag = false;
//uart callback
void kfc_input(uart_callback_args_t *p_args)
{
    /* TODO: add your own code here */
    if(UART_EVENT_TX_COMPLETE==p_args->event){
           g_data_transmit_flag=true;
    }
}

int _write(int file, char *str, int len){
    g_data_transmit_flag=false;
    R_SCI_UART_Write(&g_uart0_ctrl, str, len);
    while(!g_data_transmit_flag); //전송 완료될 때까지 대기
    return len;
}

/*******************************************************************************************************************//**
 * main() is generated by the RA Configuration editor and is used to generate threads if an RTOS is used.  This function
 * is called by main() when no RTOS is used.
 **********************************************************************************************************************/
void hal_entry(void)
{
    /* TODO: add your own code here */
    while(1){
        //R_BSP_SoftwareDelay (1000, BSP_DELAY_UNITS_MILLISECONDS);
        //uart가 다 전송될때까지 기다리지 않아서 값이 겹쳐서 display된다
        //uart interrupt를 이용해서 다 보냈음을 확인하고 다음 데이터를 전송하자

        printf("sahsadgas\r\n");
    }

}

/*******************************************************************************************************************//**
 * This function is called at various points during the startup process.  This implementation uses the event that is
 * called right before main() to set up the pins.
 *
 * @param[in]  event    Where at in the start up process the code is currently at
 **********************************************************************************************************************/
void R_BSP_WarmStart(bsp_warm_start_event_t event)
{
    if (BSP_WARM_START_RESET == event)
    {
#if BSP_FEATURE_FLASH_LP_VERSION != 0

        /* Enable reading from data flash. */
        R_FACI_LP->DFLCTL = 1U;

        /* Would normally have to wait tDSTOP(6us) for data flash recovery. Placing the enable here, before clock and
         * C runtime initialization, should negate the need for a delay since the initialization will typically take more than 6us. */
#endif
    }

    if (BSP_WARM_START_POST_C == event)
    {
        /* C runtime environment and system clocks are setup. */

        /* Configure pins. */
        R_IOPORT_Open (&g_ioport_ctrl, g_ioport.p_cfg);
        R_SCI_UART_Open(&g_uart0_ctrl, &g_uart0_cfg);

    }
}

#if BSP_TZ_SECURE_BUILD

FSP_CPP_HEADER
BSP_CMSE_NONSECURE_ENTRY void template_nonsecure_callable ();

/* Trustzone Secure Projects require at least one nonsecure callable function in order to build (Remove this if it is not required to build). */
BSP_CMSE_NONSECURE_ENTRY void template_nonsecure_callable ()
{

}
FSP_CPP_FOOTER

#endif
